## port/quigon/mainline/kernel.its
```
/dts-v1/;

/ {
	description = "ASUS Chromebook CM14 (Corsola Quigon / Obiwan) FIT Image for Depthcharge";
	#address-cells = <1>;

	images {
		kernel {
			description = "Linux Kernel ARM64";
			data = /incbin/("Image.lz4");
			type = "kernel_noload";
			arch = "arm64";
			os = "linux";
			compression = "lz4";
			load = <0>;
			entry = <0>;
			hash-1 {
				algo = "sha256";
			};
		};

		fdt-1 {
			description = "mt8186-corsola-quigon.dtb";
			data = /incbin/("mt8186-corsola-quigon.dtb");
			type = "flat_dt";
			arch = "arm64";
			compression = "none";
			hash-1 {
				algo = "sha256";
			};
		};
	};

	configurations {
		default = "conf-1";
		conf-1 {
			description = "ASUS Chromebook CM14 & Corsola (Quigon & Obiwan)";
			kernel = "kernel";
			fdt = "fdt-1";
			compatible = "google,quigon-sku0", "google,quigon-sku1", "google,quigon-sku512", "google,quigon", "google,obiwan-rev3-sku196620", "google,obiwan-rev3", "google,obiwan-sku196620", "google,obiwan", "google,corsola", "mediatek,mt8189", "mediatek,mt8186";
		};

		conf-obiwan {
			description = "Corsola Obiwan (rev3-sku196620 / ASUS CM14 / Acer)";
			kernel = "kernel";
			fdt = "fdt-1";
			compatible = "google,obiwan-rev3-sku196620", "google,obiwan-rev3", "google,obiwan-sku196620", "google,obiwan", "google,corsola", "mediatek,mt8189", "mediatek,mt8186";
		};

		conf-corsola {
			description = "Generic Corsola MT8186 / MT8189";
			kernel = "kernel";
			fdt = "fdt-1";
			compatible = "google,corsola", "mediatek,mt8189", "mediatek,mt8186";
		};
	};
};
```

## port/quigon/mainline/mt8186_quigon_defconfig
```kconfig
# ASUS Chromebook CM14 (CM1406CM4A - MT8186/MT8189 Corsola Quigon & Obiwan) Linux Defconfig
# Base: ARM64 defconfig trimmed and tuned for MediaTek Kompanio 520/540
CONFIG_ARM64=y
CONFIG_ARCH_MEDIATEK=y
CONFIG_64BIT=y
CONFIG_ARM64_VA_BITS_48=y
CONFIG_CMDLINE_FORCE=n

# General setup
CONFIG_INIT_ENV_ARG_LIMIT=32
CONFIG_COMPILE_TEST=n
CONFIG_LOCALVERSION="-quigon-mt8186"
CONFIG_POSIX_MQUEUE=y
CONFIG_AUDIT=y
CONFIG_NO_HZ_IDLE=y
CONFIG_HIGH_RES_TIMERS=y
CONFIG_PREEMPT_VOLUNTARY=y
CONFIG_IKCONFIG=y
CONFIG_IKCONFIG_PROC=y
CONFIG_LOG_BUF_SHIFT=17
CONFIG_LOG_CPU_MAX_BUF_SHIFT=12
CONFIG_CGROUPS=y
CONFIG_MEMCG=y
CONFIG_CGROUP_SCHED=y
CONFIG_UCLAMP_TASK=y
CONFIG_UCLAMP_TASK_GROUP=y
CONFIG_NAMESPACES=y
CONFIG_BLK_DEV_INITRD=y
CONFIG_INITRAMFS_SOURCE=""
CONFIG_RD_GZIP=y
CONFIG_RD_XZ=y
CONFIG_RD_LZ4=y
CONFIG_RD_ZSTD=y
CONFIG_CC_OPTIMIZE_FOR_PERFORMANCE=y

# Coreboot / Depthcharge firmware support
CONFIG_COREBOOT_TABLE=y
CONFIG_COREBOOT_FRAMEBUFFER=y
CONFIG_COREBOOT_MEMCONSOLE=y
CONFIG_COREBOOT_MEMCONSOLE_COREBOOT=y

# CPU and Power Management
CONFIG_ARM_MEDIATEK_CPUFREQ_HW=y
CONFIG_CPU_FREQ=y
CONFIG_CPU_FREQ_DEFAULT_GOV_SCHEDUTIL=y
CONFIG_CPU_FREQ_GOV_PERFORMANCE=y
CONFIG_CPU_FREQ_GOV_POWERSAVE=y
CONFIG_CPU_FREQ_GOV_USERSPACE=y
CONFIG_CPU_FREQ_GOV_ONDEMAND=y
CONFIG_CPU_IDLE=y
CONFIG_ARM_CPUIDLE=y
CONFIG_PM_AUTOSLEEP=y
CONFIG_PM_WAKELOCKS=y
CONFIG_PM_DEBUG=y
CONFIG_PM_ADVANCED_DEBUG=y

# MediaTek SoC Clocks, Pinctrl & Power Domains (MT8186 & MT8189)
CONFIG_COMMON_CLK_MT8186=y
CONFIG_COMMON_CLK_MT8186_MCUCFG=y
CONFIG_COMMON_CLK_MT8186_MMSYS=y
CONFIG_COMMON_CLK_MT8186_WPE=y
CONFIG_PINCTRL_MT8186=y
CONFIG_COMMON_CLK_MT8189=y
CONFIG_COMMON_CLK_MT8189_BUS=y
CONFIG_COMMON_CLK_MT8189_DBGAO=y
CONFIG_COMMON_CLK_MT8189_DVFSRC=y
CONFIG_COMMON_CLK_MT8189_IIC=y
CONFIG_COMMON_CLK_MT8189_MFG=y
CONFIG_COMMON_CLK_MT8189_MMSYS=y
CONFIG_COMMON_CLK_MT8189_SCP=y
CONFIG_COMMON_CLK_MT8189_UFS=y
CONFIG_COMMON_CLK_MT8189_VCODEC=y
CONFIG_PINCTRL_MT8189=y
CONFIG_MTK_SCPSYS=y
CONFIG_MTK_SCPSYS_PM_DOMAINS=y
CONFIG_MTK_CMDQ=y
CONFIG_MTK_MMSYS=y
CONFIG_MEDIATEK_WATCHDOG=y
CONFIG_SERIAL_8250_MT6577=y

# Storage: 128 GB eMMC 5.1 (MSDC0), SD Card (MSDC1) & UFS (MT8189)
CONFIG_MMC=y
CONFIG_MMC_BLOCK=y
CONFIG_MMC_BLOCK_MINORS=16
CONFIG_MMC_MTK=y
CONFIG_MMC_SDHCI=y
CONFIG_MMC_SDHCI_PLTFM=y
CONFIG_MMC_SDHCI_MTK=y
CONFIG_MMC_CQHCI=y
CONFIG_SCSI=y
CONFIG_BLK_DEV_SD=y
CONFIG_SCSI_UFSHCD=y
CONFIG_SCSI_UFSHCD_PLATFORM=y
CONFIG_SCSI_UFS_MEDIATEK=y

# PCIe & PHYs (Wi-Fi 7 MT7925, T-PHY, XS-PHY)
CONFIG_PCI=y
CONFIG_PCIEPORTBUS=y
CONFIG_PCIE_MEDIATEK_GEN3=y
CONFIG_PHY_MTK_TPHY=y
CONFIG_PHY_MTK_XSPHY=y

# Display, DRM, KMS, Framebuffer Console (Avoid Black Screen)
CONFIG_DRM=y
CONFIG_DRM_KMS_HELPER=y
CONFIG_DRM_FBDEV_EMULATION=y
CONFIG_DRM_FBDEV_OVERALLOC=100
CONFIG_FB=y
CONFIG_VT=y
CONFIG_VT_CONSOLE=y
CONFIG_FRAMEBUFFER_CONSOLE=y
CONFIG_FRAMEBUFFER_CONSOLE_DETECT_PRIMARY=y
CONFIG_FRAMEBUFFER_CONSOLE_ROTATION=y
CONFIG_FONTS=y
CONFIG_FONT_8x16=y
CONFIG_DRM_SIMPLEDRM=y
CONFIG_DRM_MEDIATEK=y
CONFIG_DRM_MEDIATEK_DP=y
CONFIG_DRM_MEDIATEK_DP_V2=y
CONFIG_DRM_MEDIATEK_DSI=y
CONFIG_DRM_ANALOGIX_ANX7625=y
CONFIG_DRM_ITE_IT61620=y
CONFIG_DRM_PANEL_EDP=y
CONFIG_DRM_PANEL_SIMPLE=y
CONFIG_DRM_DISPLAY_DP_AUX_BUS=y
CONFIG_PHY_MTK_EDP=y
CONFIG_PHY_MTK_MIPI_DSI=y
CONFIG_PWM=y
CONFIG_PWM_MTK_DISP=y
CONFIG_BACKLIGHT_CLASS_DEVICE=y
CONFIG_BACKLIGHT_PWM=y

# GPU: Mali-G57 MC2 (Panfrost)
CONFIG_DRM_PANFROST=y
CONFIG_PM_DEVFREQ=y
CONFIG_DEVFREQ_GOV_SIMPLE_ONDEMAND=y

# Wi-Fi 7 / Wi-Fi 6E (MT7921 / MT7925) & Bluetooth
CONFIG_NET=y
CONFIG_WIRELESS=y
CONFIG_CFG80211=y
CONFIG_CFG80211_WEXT=n
CONFIG_MAC80211=y
CONFIG_WLAN=y
CONFIG_WLAN_VENDOR_MEDIATEK=y
CONFIG_MT76_CORE=y
CONFIG_MT76_CONNAC_LIB=y
CONFIG_MT7921_COMMON=y
CONFIG_MT7921E=y
CONFIG_MT7925_COMMON=y
CONFIG_MT7925E=y
CONFIG_BT=y
CONFIG_BT_RFCOMM=y
CONFIG_BT_HIDP=y
CONFIG_BT_HCIBTUSB=y
CONFIG_BT_HCIBTUSB_MTK=y
CONFIG_BT_MTK=y

# ChromeOS EC, Keyboard, Lid & Battery Management
CONFIG_CHROME_PLATFORMS=y
CONFIG_CROS_EC=y
CONFIG_CROS_EC_SPI=y
CONFIG_KEYBOARD_CROS_EC=y
CONFIG_CROS_EC_BUTTONS=y
CONFIG_I2C_CROS_EC_TUNNEL=y
CONFIG_POWER_SUPPLY=y
CONFIG_BATTERY_SBS=y
CONFIG_CROS_EC_CHARDEV=y
CONFIG_CROS_EC_SYSFS=y
CONFIG_CHARGER_CROS_USBPD=y
CONFIG_CROS_USBPD_NOTIFY=y
CONFIG_TYPEC=y
CONFIG_TYPEC_UCSI=y
CONFIG_CROS_EC_UCSI=y
CONFIG_TYPEC_DP_ALTMODE=y
CONFIG_TYPEC_MUX_GPIO=y
CONFIG_TYPEC_MUX_PI3USB30532=y
CONFIG_INPUT_EVDEV=y
CONFIG_INPUT_TOUCHSCREEN=y
CONFIG_MOUSE_ELAN_I2C=y
CONFIG_MOUSE_ELAN_I2C_I2C=y
CONFIG_HID_MULTITOUCH=y
CONFIG_I2C_HID_ACPI=y
CONFIG_I2C_HID_OF=y
CONFIG_TOUCHSCREEN_ELAN=y
CONFIG_TOUCHSCREEN_GOODIX=y

# Audio (MT8186 & MT8189: Combo Jack RT5682S/DA7219/NAU8825, Speakers RT1019P/RT1015P/MAX98357A)
CONFIG_SOUND=y
CONFIG_SND=y
CONFIG_SND_SOC=y
CONFIG_SND_SOC_MEDIATEK=y
CONFIG_SND_SOC_MT8186=y
CONFIG_SND_SOC_MT8186_MT6366=y
CONFIG_SND_SOC_MT8189=y
CONFIG_SND_SOC_MT8189_NAU8825=y
CONFIG_SND_SOC_RT5682S=y
CONFIG_SND_SOC_RT1019P=y
CONFIG_SND_SOC_RT1015P=y
CONFIG_SND_SOC_DA7219=y
CONFIG_SND_SOC_MAX98357A=y
CONFIG_SND_SOC_DMIC=y

# Thermal and Sensors (MT8186 & MT8189 LVTS)
CONFIG_THERMAL=y
CONFIG_THERMAL_OF=y
CONFIG_MTK_THERMAL=y
CONFIG_MTK_SOC_THERMAL=y
CONFIG_MTK_LVTS_THERMAL=y

# USB & Camera (UVC)
CONFIG_USB_SUPPORT=y
CONFIG_USB=y
CONFIG_USB_XHCI_HCD=y
CONFIG_USB_XHCI_MTK=y
CONFIG_MEDIA_SUPPORT=y
CONFIG_MEDIA_CAMERA_SUPPORT=y
CONFIG_MEDIA_PLATFORM_SUPPORT=y
CONFIG_VIDEO_DEV=y
CONFIG_VIDEO_V4L2=y
CONFIG_USB_VIDEO_CLASS=y

# Systemd & Performance Tuning
CONFIG_ZRAM=y
CONFIG_ZRAM_BACKEND_LZ4=y
CONFIG_ZRAM_BACKEND_ZSTD=y
CONFIG_ZRAM_MULTI_COMP=y
CONFIG_EXT4_FS=y
CONFIG_EXT4_FS_POSIX_ACL=y
CONFIG_EXT4_FS_SECURITY=y
CONFIG_F2FS_FS=y
CONFIG_DEVTMPFS=y
CONFIG_DEVTMPFS_MOUNT=y
CONFIG_PSTORE=y
CONFIG_PSTORE_RAM=y
CONFIG_PSTORE_CONSOLE=y
```
